## conf/layer.conf
```bitbake
# We have a conf and classes directory, add to BBPATH
BBPATH .= ":${LAYERDIR}"

# We have recipes-* directories, add to BBFILES
BBFILES += "${LAYERDIR}/recipes-*/*.bb \
            ${LAYERDIR}/recipes-*/*.bbappend"

BBFILE_COLLECTIONS += "meta-soco"
BBFILE_PATTERN_meta-soco = "^${LAYERDIR}/"
BBFILE_PRIORITY_meta-soco = "6"

LAYERDEPENDS_meta-soco = "core"
LAYERSERIES_COMPAT_meta-soco = "dunfell"
```
